## drivers/char/pandora2/Kconfig
```kconfig
#
# Input misc drivers configuration
#
menuconfig CHAR_PANDORA2
	bool "Roku Pandora2 devices"
	help
	  Say Y here to choose various drivers for the Roku Pandora2 device.

	  If unsure, say Y.

if CHAR_PANDORA2

config ROKU_PANDORA2_IR
	tristate "Roku Pandora2 Infra-red driver"
	depends on MIPS
	depends on PNX8550
	help
	  Say Y here only if you are building for a Roku Pandora2 device.
endif
```

## drivers/net/ethernet/pmc-sierra/Kconfig
```kconfig
config NET_VENDOR_PMC_SIERRA
        bool "PMC-Sierra devices"
        default y
        depends on PMC_YOSEMITE

if NET_VENDOR_PMC_SIERRA

config TITAN_GE
	bool "PMC-Sierra TITAN Gigabit Ethernet Support"
	depends on PMC_YOSEMITE
        default y
	help
	  This enables support for the the integrated ethernet of
	  PMC-Sierra's Titan SoC.

endif # NET_VENDOR_PMC_SIERRA
```
